## config/west.yml
```yaml
manifest:
  remotes:
      # zmk official
    - name: zmkfirmware
      url-base: https://github.com/zmkfirmware
    - name: gpeye                         #new entry
      url-base: https://github.com/GPeye  #new entry
    - name: dsifry #new entry
      url-base: https://github.com/dsifry #new entry
  projects:
    - name: zmk
      remote: zmkfirmware
      revision: main
      import: app/west.yml
    - name: hammerbeam-slideshow          #new entry
      remote: gpeye                       #new entry
      revision: main                      #new entry
    - name: nice-view-mod #new entry
      remote: dsifry #new entry
      revision: main #new entry
  self:
    path: config
```
